/*
 * Mediatek's MT6877 SoC device tree source
 *
 * Copyright (C) 2021 MediaTek Inc.
 *
 * This program is free software; you can redistribute it and/or modify
 * it under the terms of the GNU General Public License version 2 as
 * published by the Free Software Foundation.
 *
 * This program is distributed in the hope that it will be useful,
 * but WITHOUT ANY WARRANTY; without even the implied warranty of
 * MERCHANTABILITY or FITNESS FOR A PARTICULAR PURPOSE.
 * See http://www.gnu.org/licenses/gpl-2.0.html for more details.
 */

&clkitg {
	status = "okay";
	bring-up {
		compatible = "mediatek,clk-bring-up";
		clocks =
			<&scpsys SCP_SYS_ISP0>,
			<&scpsys SCP_SYS_ISP1>,
			<&scpsys SCP_SYS_IPE>,
			<&scpsys SCP_SYS_VDEC>,
			<&scpsys SCP_SYS_VENC>,
			<&scpsys SCP_SYS_DISP>,
			<&scpsys SCP_SYS_AUDIO>,
			<&scpsys SCP_SYS_CAM>,
			<&scpsys SCP_SYS_CAM_RAWA>,
			<&scpsys SCP_SYS_CAM_RAWB>,
			<&scpsys SCP_SYS_CSI>,
			<&apmixedsys_clk CLK_APMIXED_UNIVPLL>,
			<&apmixedsys_clk CLK_APMIXED_MMPLL>,
			<&apmixedsys_clk CLK_APMIXED_ADSPPLL>,
			<&apmixedsys_clk CLK_APMIXED_TVDPLL>,
			<&apmixedsys_clk CLK_APMIXED_APLL1>,
			<&apmixedsys_clk CLK_APMIXED_APLL2>,
			<&apmixedsys_clk CLK_APMIXED_USBPLL>,
			<&topckgen_clk CLK_TOP_SCP_SEL>,
			<&topckgen_clk CLK_TOP_DISP0_SEL>,
			<&topckgen_clk CLK_TOP_MDP0_SEL>,
			<&topckgen_clk CLK_TOP_IMG1_SEL>,
			<&topckgen_clk CLK_TOP_IPE_SEL>,
			<&topckgen_clk CLK_TOP_DPE_SEL>,
			<&topckgen_clk CLK_TOP_CAM_SEL>,
			<&topckgen_clk CLK_TOP_CCU_SEL>,
			<&topckgen_clk CLK_TOP_CAMTG_SEL>,
			<&topckgen_clk CLK_TOP_CAMTG2_SEL>,
			<&topckgen_clk CLK_TOP_CAMTG3_SEL>,
			<&topckgen_clk CLK_TOP_CAMTG4_SEL>,
			<&topckgen_clk CLK_TOP_CAMTG5_SEL>,
			<&topckgen_clk CLK_TOP_UART_SEL>,
			<&topckgen_clk CLK_TOP_AUDIO_SEL>,
			<&topckgen_clk CLK_TOP_AUD_INTBUS_SEL>,
			<&topckgen_clk CLK_TOP_PWRAP_ULPOSC_SEL>,
			<&topckgen_clk CLK_TOP_DISP_PWM_SEL>,
			<&topckgen_clk CLK_TOP_USB_TOP_SEL>,
			<&topckgen_clk CLK_TOP_SSUSB_XHCI_SEL>,
			<&topckgen_clk CLK_TOP_SENINF_SEL>,
			<&topckgen_clk CLK_TOP_SENINF1_SEL>,
			<&topckgen_clk CLK_TOP_SENINF2_SEL>,
			<&topckgen_clk CLK_TOP_SENINF3_SEL>,
			<&topckgen_clk CLK_TOP_AUD_ENGEN1_SEL>,
			<&topckgen_clk CLK_TOP_AUD_ENGEN2_SEL>,
			<&topckgen_clk CLK_TOP_AES_UFSFDE_SEL>,
			<&topckgen_clk CLK_TOP_UFS_SEL>,
			<&topckgen_clk CLK_TOP_AUD_1_SEL>,
			<&topckgen_clk CLK_TOP_AUD_2_SEL>,
			<&topckgen_clk CLK_TOP_DPMAIF_MAIN_SEL>,
			<&topckgen_clk CLK_TOP_VENC_SEL>,
			<&topckgen_clk CLK_TOP_VDEC_SEL>,
			<&topckgen_clk CLK_TOP_CAMTM_SEL>,
			<&topckgen_clk CLK_TOP_PWM_SEL>,
			<&topckgen_clk CLK_TOP_AUDIO_H_SEL>,
			<&topckgen_clk CLK_TOP_SPMI_M_MST_SEL>,
			<&topckgen_clk CLK_TOP_UFS_MBIST_SEL>,
			<&topckgen_clk CLK_TOP_APLL_I2S0_MCK_SEL>,
			<&topckgen_clk CLK_TOP_APLL_I2S1_MCK_SEL>,
			<&topckgen_clk CLK_TOP_APLL_I2S2_MCK_SEL>,
			<&topckgen_clk CLK_TOP_APLL_I2S3_MCK_SEL>,
			<&topckgen_clk CLK_TOP_APLL_I2S4_MCK_SEL>,
			<&topckgen_clk CLK_TOP_APLL_I2S5_MCK_SEL>,
			<&topckgen_clk CLK_TOP_APLL_I2S6_MCK_SEL>,
			<&topckgen_clk CLK_TOP_APLL_I2S7_MCK_SEL>,
			<&topckgen_clk CLK_TOP_APLL_I2S8_MCK_SEL>,
			<&topckgen_clk CLK_TOP_APLL_I2S9_MCK_SEL>,
			<&topckgen_clk CLK_TOP_APLL12_CK_DIV0>,
			<&topckgen_clk CLK_TOP_APLL12_CK_DIV1>,
			<&topckgen_clk CLK_TOP_APLL12_CK_DIV2>,
			<&topckgen_clk CLK_TOP_APLL12_CK_DIV3>,
			<&topckgen_clk CLK_TOP_APLL12_CK_DIV4>,
			<&topckgen_clk CLK_TOP_APLL12_CK_DIVB>,
			<&topckgen_clk CLK_TOP_APLL12_CK_DIV5>,
			<&topckgen_clk CLK_TOP_APLL12_CK_DIV6>,
			<&topckgen_clk CLK_TOP_APLL12_CK_DIV7>,
			<&topckgen_clk CLK_TOP_APLL12_CK_DIV8>,
			<&topckgen_clk CLK_TOP_APLL12_CK_DIV9>,
			<&infracfg_ao_clk CLK_IFRAO_PMIC_TMR>,
			<&infracfg_ao_clk CLK_IFRAO_PMIC_AP>,
			<&infracfg_ao_clk CLK_IFRAO_PMIC_MD>,
			<&infracfg_ao_clk CLK_IFRAO_PMIC_CONN>,
			<&infracfg_ao_clk CLK_IFRAO_APXGPT>,
			<&infracfg_ao_clk CLK_IFRAO_GCE>,
			<&infracfg_ao_clk CLK_IFRAO_GCE2>,
			<&infracfg_ao_clk CLK_IFRAO_PWM_HCLK>,
			<&infracfg_ao_clk CLK_IFRAO_PWM1>,
			<&infracfg_ao_clk CLK_IFRAO_PWM2>,
			<&infracfg_ao_clk CLK_IFRAO_PWM3>,
			<&infracfg_ao_clk CLK_IFRAO_PWM4>,
			<&infracfg_ao_clk CLK_IFRAO_PWM>,
			<&infracfg_ao_clk CLK_IFRAO_UART0>,
			<&infracfg_ao_clk CLK_IFRAO_UART1>,
			<&infracfg_ao_clk CLK_IFRAO_UART2>,
			<&infracfg_ao_clk CLK_IFRAO_UART3>,
			<&infracfg_ao_clk CLK_IFRAO_GCE_26M>,
			<&infracfg_ao_clk CLK_IFRAO_BTIF>,
			<&infracfg_ao_clk CLK_IFRAO_AUXADC>,
			<&infracfg_ao_clk CLK_IFRAO_CPUM>,
			<&infracfg_ao_clk CLK_IFRAO_AUXADC_MD>,
			<&infracfg_ao_clk CLK_IFRAO_AUDIO>,
			<&infracfg_ao_clk CLK_IFRAO_DXCC_SEC_CORE>,
			<&infracfg_ao_clk CLK_IFRAO_SSUSB>,
			<&infracfg_ao_clk CLK_IFRAO_DISP_PWM>,
			<&infracfg_ao_clk CLK_IFRAO_AUDIO_26M_BCLK>,
			<&infracfg_ao_clk CLK_IFRAO_UNIPRO_SYSCLK>,
			<&infracfg_ao_clk CLK_IFRAO_UFS_MP_SAP_BCLK>,
			<&infracfg_ao_clk CLK_IFRAO_APDMA>,
			<&infracfg_ao_clk CLK_IFRAO_UFS>,
			<&infracfg_ao_clk CLK_IFRAO_AES_UFSFDE>,
			<&infracfg_ao_clk CLK_IFRAO_SSUSB_XHCI>,
			<&infracfg_ao_clk CLK_IFRAO_FBIST2FPC>,
			<&infracfg_ao_clk CLK_IFRAO_RG_MUX_TIA_CK>,
			<&infracfg_ao_clk CLK_IFRAO_RG_PWARP_SYS_P_CK>,
			<&infracfg_ao_clk CLK_IFRAO_RG_AES_CK_0P_CK>,
			<&infracfg_ao_clk CLK_IFRAO_RG_PWRAP_TMR_P_CK>,
			<&infracfg_ao_clk CLK_IFRAO_RG_PERI_UFS_FMEM_SUB_CK>,
			<&audio_clk CLK_AUDSYS_AFE>,
			<&audio_clk CLK_AUDSYS_22M>,
			<&audio_clk CLK_AUDSYS_24M>,
			<&audio_clk CLK_AUDSYS_APLL2_TUNER>,
			<&audio_clk CLK_AUDSYS_APLL_TUNER>,
			<&audio_clk CLK_AUDSYS_TDM>,
			<&audio_clk CLK_AUDSYS_ADC>,
			<&audio_clk CLK_AUDSYS_DAC>,
			<&audio_clk CLK_AUDSYS_DAC_PREDIS>,
			<&audio_clk CLK_AUDSYS_TML>,
			<&audio_clk CLK_AUDSYS_NLE>,
			<&audio_clk CLK_AUDSYS_CONNSYS_I2S_ASRC>,
			<&audio_clk CLK_AUDSYS_GENERAL1_ASRC>,
			<&audio_clk CLK_AUDSYS_GENERAL2_ASRC>,
			<&audio_clk CLK_AUDSYS_DAC_HIRES>,
			<&audio_clk CLK_AUDSYS_ADC_HIRES>,
			<&audio_clk CLK_AUDSYS_ADC_HIRES_TML>,
			<&audio_clk CLK_AUDSYS_ADDA6_ADC>,
			<&audio_clk CLK_AUDSYS_ADDA6_ADC_HIRES>,
			<&audio_clk CLK_AUDSYS_3RD_DAC>,
			<&audio_clk CLK_AUDSYS_3RD_DAC_PREDIS>,
			<&audio_clk CLK_AUDSYS_3RD_DAC_TML>,
			<&audio_clk CLK_AUDSYS_3RD_DAC_HIRES>,
			<&mmsys_config_clk CLK_MM_DISP_MUTEX0>,
			<&mmsys_config_clk CLK_MM_APB_BUS>,
			<&mmsys_config_clk CLK_MM_DISP_OVL0>,
			<&mmsys_config_clk CLK_MM_DISP_RDMA0>,
			<&mmsys_config_clk CLK_MM_DISP_OVL0_2L>,
			<&mmsys_config_clk CLK_MM_DISP_WDMA0>,
			<&mmsys_config_clk CLK_MM_DISP_CCORR1>,
			<&mmsys_config_clk CLK_MM_DISP_RSZ0>,
			<&mmsys_config_clk CLK_MM_DISP_AAL0>,
			<&mmsys_config_clk CLK_MM_DISP_CCORR0>,
			<&mmsys_config_clk CLK_MM_DISP_COLOR0>,
			<&mmsys_config_clk CLK_MM_SMI_INFRA>,
			<&mmsys_config_clk CLK_MM_DISP_GAMMA0>,
			<&mmsys_config_clk CLK_MM_DISP_POSTMASK0>,
			<&mmsys_config_clk CLK_MM_DISP_SPR0>,
			<&mmsys_config_clk CLK_MM_DISP_DITHER0>,
			<&mmsys_config_clk CLK_MM_SMI_COMMON>,
			<&mmsys_config_clk CLK_MM_DISP_CM0>,
			<&mmsys_config_clk CLK_MM_DSI0>,
			<&mmsys_config_clk CLK_MM_SMI_GALS>,
			<&mmsys_config_clk CLK_MM_DISP_DSC_WRAP>,
			<&mmsys_config_clk CLK_MM_SMI_IOMMU>,
			<&mmsys_config_clk CLK_MM_DISP_OVL1_2L>,
			<&mmsys_config_clk CLK_MM_DISP_UFBC_WDMA0>,
			<&mmsys_config_clk CLK_MM_DSI0_DSI_CK_DOMAIN>,
			<&mmsys_config_clk CLK_MM_DISP_26M>,
			<&imgsys1_clk CLK_IMGSYS1_LARB9>,
			<&imgsys1_clk CLK_IMGSYS1_DIP>,
			<&imgsys1_clk CLK_IMGSYS1_GALS>,
			<&imgsys2_clk CLK_IMGSYS2_LARB9>,
			<&imgsys2_clk CLK_IMGSYS2_LARB10>,
			<&imgsys2_clk CLK_IMGSYS2_MFB>,
			<&imgsys2_clk CLK_IMGSYS2_WPE>,
			<&imgsys2_clk CLK_IMGSYS2_MSS>,
			<&imgsys2_clk CLK_IMGSYS2_GALS>,
			<&vdec_gcon_clk CLK_VDE2_VDEC_CKEN>,
			<&venc_gcon_clk CLK_VEN1_CKE0_LARB>,
			<&venc_gcon_clk CLK_VEN1_CKE1_VENC>,
			<&venc_gcon_clk CLK_VEN1_CKE2_JPGENC>,
			<&venc_gcon_clk CLK_VEN1_CKE5_GALS>,
			<&camsys_main_clk CLK_CAM_M_LARB13>,
			<&camsys_main_clk CLK_CAM_M_LARB14>,
			<&camsys_main_clk CLK_CAM_M_RESERVED0>,
			<&camsys_main_clk CLK_CAM_M_CAM>,
			<&camsys_main_clk CLK_CAM_M_CAMTG>,
			<&camsys_main_clk CLK_CAM_M_SENINF>,
			<&camsys_main_clk CLK_CAM_M_CAMSV0>,
			<&camsys_main_clk CLK_CAM_M_CAMSV1>,
			<&camsys_main_clk CLK_CAM_M_CAMSV2>,
			<&camsys_main_clk CLK_CAM_M_CAMSV3>,
			<&camsys_main_clk CLK_CAM_M_MRAW0>,
			<&camsys_main_clk CLK_CAM_M_RESERVED2>,
			<&camsys_main_clk CLK_CAM_M_CCU_GALS>,
			<&camsys_main_clk CLK_CAM_M_CAM2MM_GALS>,
			<&camsys_rawa_clk CLK_CAM_RA_LARBX>,
			<&camsys_rawa_clk CLK_CAM_RA_CAM>,
			<&camsys_rawa_clk CLK_CAM_RA_CAMTG>,
			<&camsys_rawb_clk CLK_CAM_RB_LARBX>,
			<&camsys_rawb_clk CLK_CAM_RB_CAM>,
			<&camsys_rawb_clk CLK_CAM_RB_CAMTG>,
			<&ipesys_clk CLK_IPE_LARB19>,
			<&ipesys_clk CLK_IPE_LARB20>,
			<&ipesys_clk CLK_IPE_SMI_SUBCOM>,
			<&ipesys_clk CLK_IPE_FD>,
			<&ipesys_clk CLK_IPE_FE>,
			<&ipesys_clk CLK_IPE_RSC>,
			<&ipesys_clk CLK_IPE_DPE>,
			<&ipesys_clk CLK_IPE_GALS>,
			<&mdpsys_config_clk CLK_MDP_RDMA0>,
			<&mdpsys_config_clk CLK_MDP_TDSHP0>,
			<&mdpsys_config_clk CLK_MDP_IMG_DL_ASYNC0>,
			<&mdpsys_config_clk CLK_MDP_IMG_DL_ASYNC1>,
			<&mdpsys_config_clk CLK_MDP_RDMA1>,
			<&mdpsys_config_clk CLK_MDP_TDSHP1>,
			<&mdpsys_config_clk CLK_MDP_SMI0>,
			<&mdpsys_config_clk CLK_MDP_APB_BUS>,
			<&mdpsys_config_clk CLK_MDP_WROT0>,
			<&mdpsys_config_clk CLK_MDP_RSZ0>,
			<&mdpsys_config_clk CLK_MDP_HDR0>,
			<&mdpsys_config_clk CLK_MDP_MUTEX0>,
			<&mdpsys_config_clk CLK_MDP_WROT1>,
			<&mdpsys_config_clk CLK_MDP_RSZ1>,
			<&mdpsys_config_clk CLK_MDP_AAL0>,
			<&mdpsys_config_clk CLK_MDP_AAL1>,
			<&mdpsys_config_clk CLK_MDP_COLOR0>,
			<&mdpsys_config_clk CLK_MDP_IMG_DL_RELAY0_ASYNC0>,
			<&mdpsys_config_clk CLK_MDP_IMG_DL_RELAY1_ASYNC1>;
	};
};
