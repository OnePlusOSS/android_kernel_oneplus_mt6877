## mm/oplus_healthinfo/Kconfig
```kconfig
#ifdef OPLUS_FEATURE_HEALTHINFO
#/* 2018-07-07, add alloc wait monitor support*/
config OPLUS_MEM_MONITOR
	bool "memory monitor "
	default n
	help
	 memory monitor.
#endif /* OPLUS_FEATURE_HEALTHINFO */
```
